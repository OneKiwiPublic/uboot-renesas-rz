## board/onekiwi/renesas-rzg2l-evk/Kconfig
```kconfig
if TARGET_RENESAS_RZG2L_EVK

config SYS_SOC
	default "rmobile"

config SYS_BOARD
	default "renesas-rzg2l-evk"

config SYS_VENDOR
	default "onekiwi"

config SYS_CONFIG_NAME
	default "renesas-rzg2l-evk"

endif
```

## board/onekiwi/solidrun-rzg2lc/Kconfig
```kconfig
if TARGET_SOLIDRUN_RZG2LC

config SYS_SOC
	default "rmobile"

config SYS_BOARD
	default "solidrun-rzg2lc"

config SYS_VENDOR
	default "onekiwi"

config SYS_CONFIG_NAME
	default "solidrun-rzg2lc"

endif
```
